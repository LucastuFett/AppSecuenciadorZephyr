## app/build/Kconfig/arch/Kconfig
```kconfig
# Load Zephyr Arch Kconfig descriptions.
osource "/Users/lucasgutie/zephyrapp/zephyr/arch/x86/Kconfig"
osource "/Users/lucasgutie/zephyrapp/zephyr/arch/xtensa/Kconfig"
osource "/Users/lucasgutie/zephyrapp/zephyr/arch/sparc/Kconfig"
osource "/Users/lucasgutie/zephyrapp/zephyr/arch/riscv/Kconfig"
osource "/Users/lucasgutie/zephyrapp/zephyr/arch/posix/Kconfig"
osource "/Users/lucasgutie/zephyrapp/zephyr/arch/nios2/Kconfig"
osource "/Users/lucasgutie/zephyrapp/zephyr/arch/mips/Kconfig"
osource "/Users/lucasgutie/zephyrapp/zephyr/arch/arm64/Kconfig"
osource "/Users/lucasgutie/zephyrapp/zephyr/arch/arm/Kconfig"
osource "/Users/lucasgutie/zephyrapp/zephyr/arch/arc/Kconfig"
```

## app/build/Kconfig/boards/Kconfig
```kconfig
# Load Zephyr board Kconfig descriptions.
osource "/Users/lucasgutie/zephyrapp/zephyr/boards/others/stm32_min_dev/Kconfig"
```

## app/build/Kconfig/boards/Kconfig.defconfig
```kconfig
# Load Zephyr board defconfig descriptions.
osource "/Users/lucasgutie/zephyrapp/zephyr/boards/others/stm32_min_dev/Kconfig.defconfig"
```

## app/build/Kconfig/soc/Kconfig
```kconfig
# Load Zephyr SoC Kconfig descriptions.
osource "/Users/lucasgutie/zephyrapp/zephyr/soc/xlnx/zynqmp/Kconfig"
osource "/Users/lucasgutie/zephyrapp/zephyr/soc/xlnx/zynq7000/Kconfig"
osource "/Users/lucasgutie/zephyrapp/zephyr/soc/xen/Kconfig"
osource "/Users/lucasgutie/zephyrapp/zephyr/soc/wch/ch32v00x/Kconfig"
osource "/Users/lucasgutie/zephyrapp/zephyr/soc/ti/simplelink/Kconfig"
osource "/Users/lucasgutie/zephyrapp/zephyr/soc/ti/lm3s6965/Kconfig"
osource "/Users/lucasgutie/zephyrapp/zephyr/soc/ti/k3/Kconfig"
osource "/Users/lucasgutie/zephyrapp/zephyr/soc/telink/tlsr/Kconfig"
osource "/Users/lucasgutie/zephyrapp/zephyr/soc/starfive/jh71xx/Kconfig"
osource "/Users/lucasgutie/zephyrapp/zephyr/soc/st/stm32/Kconfig"
osource "/Users/lucasgutie/zephyrapp/zephyr/soc/snps/qemu_arc/Kconfig"
osource "/Users/lucasgutie/zephyrapp/zephyr/soc/snps/nsim/arc_v/Kconfig"
osource "/Users/lucasgutie/zephyrapp/zephyr/soc/snps/nsim/arc_classic/Kconfig"
osource "/Users/lucasgutie/zephyrapp/zephyr/soc/snps/hsdk4xd/Kconfig"
osource "/Users/lucasgutie/zephyrapp/zephyr/soc/snps/hsdk/Kconfig"
osource "/Users/lucasgutie/zephyrapp/zephyr/soc/snps/emsk/Kconfig"
osource "/Users/lucasgutie/zephyrapp/zephyr/soc/snps/emsdp/Kconfig"
osource "/Users/lucasgutie/zephyrapp/zephyr/soc/snps/arc_iot/Kconfig"
osource "/Users/lucasgutie/zephyrapp/zephyr/soc/silabs/Kconfig"
osource "/Users/lucasgutie/zephyrapp/zephyr/soc/sifive/sifive_freedom/Kconfig"
osource "/Users/lucasgutie/zephyrapp/zephyr/soc/sensry/Kconfig"
osource "/Users/lucasgutie/zephyrapp/zephyr/soc/rockchip/Kconfig"
osource "/Users/lucasgutie/zephyrapp/zephyr/soc/renode/riscv_virtual/Kconfig"
osource "/Users/lucasgutie/zephyrapp/zephyr/soc/renode/cortex_r8_virtual/Kconfig"
osource "/Users/lucasgutie/zephyrapp/zephyr/soc/renesas/smartbond/Kconfig"
osource "/Users/lucasgutie/zephyrapp/zephyr/soc/renesas/rzt2m/Kconfig"
osource "/Users/lucasgutie/zephyrapp/zephyr/soc/renesas/rz/Kconfig"
osource "/Users/lucasgutie/zephyrapp/zephyr/soc/renesas/rcar/Kconfig"
osource "/Users/lucasgutie/zephyrapp/zephyr/soc/renesas/ra/Kconfig"
osource "/Users/lucasgutie/zephyrapp/zephyr/soc/raspberrypi/Kconfig"
osource "/Users/lucasgutie/zephyrapp/zephyr/soc/quicklogic/eos_s3/Kconfig"
osource "/Users/lucasgutie/zephyrapp/zephyr/soc/qemu/virt_riscv/Kconfig"
osource "/Users/lucasgutie/zephyrapp/zephyr/soc/qemu/malta/Kconfig"
osource "/Users/lucasgutie/zephyrapp/zephyr/soc/openisa/rv32m1/Kconfig"
osource "/Users/lucasgutie/zephyrapp/zephyr/soc/nxp/s32/Kconfig"
osource "/Users/lucasgutie/zephyrapp/zephyr/soc/nxp/rw/Kconfig"
osource "/Users/lucasgutie/zephyrapp/zephyr/soc/nxp/mcx/Kconfig"
osource "/Users/lucasgutie/zephyrapp/zephyr/soc/nxp/lpc/Kconfig"
osource "/Users/lucasgutie/zephyrapp/zephyr/soc/nxp/layerscape/Kconfig"
osource "/Users/lucasgutie/zephyrapp/zephyr/soc/nxp/kinetis/Kconfig"
osource "/Users/lucasgutie/zephyrapp/zephyr/soc/nxp/imxrt/Kconfig"
osource "/Users/lucasgutie/zephyrapp/zephyr/soc/nxp/imx/Kconfig"
osource "/Users/lucasgutie/zephyrapp/zephyr/soc/nuvoton/numicro/Kconfig"
osource "/Users/lucasgutie/zephyrapp/zephyr/soc/nuvoton/numaker/Kconfig"
osource "/Users/lucasgutie/zephyrapp/zephyr/soc/nuvoton/npcx/Kconfig"
osource "/Users/lucasgutie/zephyrapp/zephyr/soc/nuvoton/npcm/Kconfig"
osource "/Users/lucasgutie/zephyrapp/zephyr/soc/nordic/Kconfig"
osource "/Users/lucasgutie/zephyrapp/zephyr/soc/neorv32/Kconfig"
osource "/Users/lucasgutie/zephyrapp/zephyr/soc/native/inf_clock/Kconfig"
osource "/Users/lucasgutie/zephyrapp/zephyr/soc/microchip/miv/Kconfig"
osource "/Users/lucasgutie/zephyrapp/zephyr/soc/microchip/mec/Kconfig"
osource "/Users/lucasgutie/zephyrapp/zephyr/soc/mediatek/mt8xxx/Kconfig"
osource "/Users/lucasgutie/zephyrapp/zephyr/soc/lowrisc/opentitan/Kconfig"
osource "/Users/lucasgutie/zephyrapp/zephyr/soc/litex/litex_vexriscv/Kconfig"
osource "/Users/lucasgutie/zephyrapp/zephyr/soc/ite/ec/Kconfig"
osource "/Users/lucasgutie/zephyrapp/zephyr/soc/intel/raptor_lake/Kconfig"
osource "/Users/lucasgutie/zephyrapp/zephyr/soc/intel/lakemont/Kconfig"
osource "/Users/lucasgutie/zephyrapp/zephyr/soc/intel/intel_socfpga_std/Kconfig"
osource "/Users/lucasgutie/zephyrapp/zephyr/soc/intel/intel_socfpga/Kconfig"
osource "/Users/lucasgutie/zephyrapp/zephyr/soc/intel/intel_niosv/Kconfig"
osource "/Users/lucasgutie/zephyrapp/zephyr/soc/intel/intel_ish/Kconfig"
osource "/Users/lucasgutie/zephyrapp/zephyr/soc/intel/intel_adsp/Kconfig"
osource "/Users/lucasgutie/zephyrapp/zephyr/soc/intel/elkhart_lake/Kconfig"
osource "/Users/lucasgutie/zephyrapp/zephyr/soc/intel/atom/Kconfig"
osource "/Users/lucasgutie/zephyrapp/zephyr/soc/intel/apollo_lake/Kconfig"
osource "/Users/lucasgutie/zephyrapp/zephyr/soc/intel/alder_lake/Kconfig"
osource "/Users/lucasgutie/zephyrapp/zephyr/soc/infineon/cat3/Kconfig"
osource "/Users/lucasgutie/zephyrapp/zephyr/soc/infineon/cat1b/Kconfig"
osource "/Users/lucasgutie/zephyrapp/zephyr/soc/infineon/cat1a/Kconfig"
osource "/Users/lucasgutie/zephyrapp/zephyr/soc/gd/gd32/Kconfig"
osource "/Users/lucasgutie/zephyrapp/zephyr/soc/gaisler/leon3/Kconfig"
osource "/Users/lucasgutie/zephyrapp/zephyr/soc/gaisler/gr716a/Kconfig"
osource "/Users/lucasgutie/zephyrapp/zephyr/soc/espressif/Kconfig"
osource "/Users/lucasgutie/zephyrapp/zephyr/soc/ene/kb1200/Kconfig"
osource "/Users/lucasgutie/zephyrapp/zephyr/soc/efinix/sapphire/Kconfig"
osource "/Users/lucasgutie/zephyrapp/zephyr/soc/cdns/xtensa_sample_controller/Kconfig"
osource "/Users/lucasgutie/zephyrapp/zephyr/soc/cdns/sample_controller32/Kconfig"
osource "/Users/lucasgutie/zephyrapp/zephyr/soc/cdns/dc233c/Kconfig"
osource "/Users/lucasgutie/zephyrapp/zephyr/soc/brcm/bcmvk/Kconfig"
osource "/Users/lucasgutie/zephyrapp/zephyr/soc/brcm/bcm2712/Kconfig"
osource "/Users/lucasgutie/zephyrapp/zephyr/soc/brcm/bcm2711/Kconfig"
osource "/Users/lucasgutie/zephyrapp/zephyr/soc/atmel/sam0/Kconfig"
osource "/Users/lucasgutie/zephyrapp/zephyr/soc/atmel/sam/Kconfig"
osource "/Users/lucasgutie/zephyrapp/zephyr/soc/aspeed/Kconfig"
osource "/Users/lucasgutie/zephyrapp/zephyr/soc/arm/Kconfig"
osource "/Users/lucasgutie/zephyrapp/zephyr/soc/arm/beetle/Kconfig"
osource "/Users/lucasgutie/zephyrapp/zephyr/soc/andestech/Kconfig"
osource "/Users/lucasgutie/zephyrapp/zephyr/soc/amd/acp_6_0/Kconfig"
osource "/Users/lucasgutie/zephyrapp/zephyr/soc/ambiq/Kconfig"
osource "/Users/lucasgutie/zephyrapp/zephyr/soc/altr/zephyr_nios2f/Kconfig"
osource "/Users/lucasgutie/zephyrapp/zephyr/soc/altr/qemu_nios2/Kconfig"
osource "/Users/lucasgutie/zephyrapp/zephyr/soc/adi/max32/Kconfig"
```
